## Documentation/devicetree/bindings/mailbox/qcom,cpucp-mbox.yaml
```yaml
# SPDX-License-Identifier: GPL-2.0 OR BSD-2-Clause
%YAML 1.2
---
$id: http://devicetree.org/schemas/mailbox/qcom,cpucp-mbox.yaml#
$schema: http://devicetree.org/meta-schemas/core.yaml#

title: Qualcomm Technologies, Inc. CPUCP Mailbox Controller

maintainers:
  - Sibi Sankar <quic_sibis@qti.qualcomm.com>

description:
  The CPUSS Control Processor (CPUCP) mailbox controller enables communication
  between AP and CPUCP by acting as a doorbell between them.

properties:
  compatible:
    items:
      - enum:
          - qcom,x1e80100-cpucp-mbox
      - const: qcom,cpucp-mbox

  reg:
    items:
      - description: CPUCP rx register region
      - description: CPUCP tx register region

  interrupts:
    maxItems: 1

  "#mbox-cells":
    const: 1

required:
  - compatible
  - reg
  - interrupts
  - "#mbox-cells"

additionalProperties: false

examples:
  - |
    #include <dt-bindings/interrupt-controller/arm-gic.h>

    mailbox@17430000 {
        compatible = "qcom,x1e80100-cpucp-mbox", "qcom,cpucp-mbox";
        reg = <0x17430000 0x10000>, <0x18830000 0x300>;
        interrupts = <GIC_SPI 62 IRQ_TYPE_LEVEL_HIGH>;
        #mbox-cells = <1>;
    };
```

## Documentation/devicetree/bindings/phy/qcom,snps-usb-ssphy.txt
```
Qualcomm Synopsys 1.0.0 SS phy controller
===========================================

Qualcomm 1.0.0 SS phy controller supports SuperSpeed USB connectivity on
some Qualcomm platforms.

Required properties:

- compatible:
    Value type: <string>
    Definition: Should contain "qcom,snps-usb-ssphy".

- reg:
    Value type: <prop-encoded-array>
    Definition: USB PHY base address and length of the register map.

- #phy-cells:
    Value type: <u32>
    Definition: Should be 0. See phy/phy-bindings.txt for details.

- clocks:
    Value type: <prop-encoded-array>
    Definition: See clock-bindings.txt section "consumers". List of
		 three clock specifiers for reference, phy core and
		 pipe clocks.

- clock-names:
    Value type: <string>
    Definition: Names of the clocks in 1-1 correspondence with the "clocks"
		 property. Must contain "ref", "phy" and "pipe".

- vdd-supply:
    Value type: <phandle>
    Definition: phandle to the regulator VDD supply node.

- vdda1p8-supply:
    Value type: <phandle>
    Definition: phandle to the regulator 1.8V supply node.

Optional properties:

- resets:
    Value type: <prop-encoded-array>
    Definition: See reset.txt section "consumers". Specifiers for COM and
		 PHY resets.

- reset-names:
    Value type: <string>
    Definition: Names of the resets in 1-1 correspondence with the "resets"
		 property. Must contain "com" and "phy" if the property is
		 specified.

Required child nodes:

- usb connector node as defined in bindings/connector/usb-connector.txt
  containing the property vbus-supply.

Example:

usb3_phy: usb3-phy@78000 {
	compatible = "qcom,snps-usb-ssphy";
	reg = <0x78000 0x400>;
	#phy-cells = <0>;
	clocks = <&rpmcc RPM_SMD_LN_BB_CLK>,
		 <&gcc GCC_USB_HS_PHY_CFG_AHB_CLK>,
		 <&gcc GCC_USB3_PHY_PIPE_CLK>;
	clock-names = "ref", "phy", "pipe";
	resets = <&gcc GCC_USB3_PHY_BCR>,
		 <&gcc GCC_USB3PHY_PHY_BCR>;
	reset-names = "com", "phy";
	vdd-supply = <&vreg_l3_1p05>;
	vdda1p8-supply = <&vreg_l5_1p8>;
	usb3_c_connector: usb3-c-connector {
		compatible = "usb-c-connector";
		label = "USB-C";
		type = "micro";
		vbus-supply = <&usb3_vbus_reg>;
	};
};
```

## Documentation/devicetree/bindings/phy/qcom,usb-hs-28nm.yaml
```yaml
# SPDX-License-Identifier: (GPL-2.0-only OR BSD-2-Clause)
%YAML 1.2
---
$id: "http://devicetree.org/schemas/phy/qcom,usb-hs-28nm.yaml#"
$schema: "http://devicetree.org/meta-schemas/core.yaml#"

title: Qualcomm Synopsys 28nm Femto High-Speed PHY

maintainers:
  - Bryan O'Donoghue <bryan.odonoghue@linaro.org>

description: |
  Qualcomm 28nm Synopsys USB LS/FS/HS USH PHY

properties:
  compatible:
    enum:
      - qcom,qcs404-usb-hsphy

  reg:
    maxItems: 1
    description: USB PHY base address and length of the register map.

  "#phy-cells":
    const: 0
    description: Should be 0. See phy/phy-bindings.txt for details.

  clocks:
    items:
      - description: Rescource Power Management clock
      - descirption: PHY AHB clock
      - description: Retention clock

  clock-names:
    items:
      - const: ref
      - const: phy
      - const: sleep

  resets:
    items:
      - description: PHY core reset
      - description: POR reset

  reset-names:
    items:
      - description: phy
      - description: por

  vdd-supply:
    maxItems: 1
    description: phandle to the regulator VDD supply node.

  vdda1p8-supply:
    maxItems: 1
    description: phandle to the regulator 1.8V supply node.

  vdda3p3-supply:
    maxItems: 1
    description: phandle to the regulator 3.3V supply node.

Example:

	phy@7a000 {
		compatible = "qcom,qcs404-usb-hsphy";
		reg = <0x7a000 0x200>;
		#phy-cells = <0>;
		clocks = <&rpmcc RPM_SMD_LN_BB_CLK>,
			 <&gcc GCC_USB_HS_PHY_CFG_AHB_CLK>,
			 <&gcc GCC_USB2A_PHY_SLEEP_CLK>;
		clock-names = "ref", "phy", "sleep";
		resets = <&gcc GCC_USB_HS_PHY_CFG_AHB_BCR>,
			 <&gcc GCC_USB2A_PHY_BCR>;
		reset-names = "phy", "por";
		vdd-supply = <&vreg_l4_1p2>;
		vdda1p8-supply = <&vreg_l5_1p8>;
		vdda3p3-supply = <&vreg_l12_3p3>;
	};
```

## Documentation/devicetree/bindings/qcom,usb-ss.yaml
```yaml
# SPDX-License-Identifier: (GPL-2.0-only OR BSD-2-Clause)
%YAML 1.2
---
$id: "http://devicetree.org/schemas/phy/qcom,usb-ss.yaml#"
$schema: "http://devicetree.org/meta-schemas/core.yaml#"

title: Qualcomm Synopsys 1.0.0 SuperSpeed USB PHY

maintainers:
  - Bryan O'Donoghue <bryan.odonoghue@linaro.org>

description: |
  Qualcomm Synopsys 1.0.0 SuperSpeed USB PHY.

properties:

- compatible:
    enum:
      - qcom,usb-ssphy

  reg:
    maxItems: 1
    description: USB PHY base address and length of the register map.

  "#phy-cells":
    const: 0
    description: Should be 0. See phy/phy-bindings.txt for details.

  clocks:
    items:
      - description: Block reference clock
      - description: PHY AHB clock
      - description: SuperSpeed pipe clock

  clock-names:
    items:
      - const: ref
      - const: phy
      - const: sleep

  vdd-supply:
    maxItems: 1
    description: phandle to the regulator VDD supply node.

  vdda1p8-supply:
    maxItems: 1
    description: phandle to the regulator 1.8V supply node.

  resets:
    items:
      - description: COM reset
      - description: PHY reset line

  reset-names:
    items:
      - description: com
      - description: phy

Example:

usb3_phy: usb3-phy@78000 {
	compatible = "qcom,usb-ssphy";
	reg = <0x78000 0x400>;
	#phy-cells = <0>;
	clocks = <&rpmcc RPM_SMD_LN_BB_CLK>,
		 <&gcc GCC_USB_HS_PHY_CFG_AHB_CLK>,
		 <&gcc GCC_USB3_PHY_PIPE_CLK>;
	clock-names = "ref", "phy", "pipe";
	resets = <&gcc GCC_USB3_PHY_BCR>,
		 <&gcc GCC_USB3PHY_PHY_BCR>;
	reset-names = "com", "phy";
	vdd-supply = <&vreg_l3_1p05>;
	vdda1p8-supply = <&vreg_l5_1p8>;
};
```
